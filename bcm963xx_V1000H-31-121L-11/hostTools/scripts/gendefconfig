## bcm963xx_V1000H-31-121L-11/kernel/linux/arch/mips/bcm963xx/Kconfig
```kconfig
# Kernel and Driver configuration for Broadcom Commengine ADSL board
choice
	prompt "Broadcom Commengine ADSL board"
	depends on MIPS_BRCM
	default BCM96362
	help
	  Select different Broadcom ADSL board

config BCM96368
	bool "96368 VDSL board"
	select DMA_NONCOHERENT
	select SYS_SUPPORTS_SMP
	select NR_CPUS_DEFAULT_2
	select BRCM_DCACHE_SHARED

config BCM96816
	bool "96816 GPON board"
	select SYS_SUPPORTS_SMP
	select DMA_NONCOHERENT
	select NR_CPUS_DEFAULT_2
	select BRCM_DCACHE_SHARED

config BCM96362
	bool "96362 ADSL board"
	select DMA_NONCOHERENT
	select SYS_SUPPORTS_SMP
	select NR_CPUS_DEFAULT_2
	select BRCM_DCACHE_SHARED

config BCM96328
	bool "96328 ADSL board"
	select DMA_NONCOHERENT
	select SYS_SUPPORTS_SMP
	select NR_CPUS_DEFAULT_2
	select BRCM_DCACHE_SHARED

config BCM963268
	bool "963268 VDSL board"
	select DMA_NONCOHERENT
	select SYS_SUPPORTS_SMP
	select NR_CPUS_DEFAULT_2
	select BRCM_DCACHE_SHARED

endchoice

config BCM_SCHED_RT_PERIOD
	int "Period over which RT task cpu usage is measured (in us)"
	range 0 1000000

config BCM_SCHED_RT_RUNTIME
	int "Portion of the period that RT tasks are allowed to run (in us)"
	range 0 1000000

config BRCM_DCACHE_SHARED
	bool "Enable Shared D-Cache Support"
	depends on SMP
	default n

config BRCM_TLB_SHARED
	bool "Enable Shared TLB Support"
	depends on SMP
	default n

config BCM_HARDIRQ_COUNT_CYCLES
    bool "Enable cycle counter to track time spent in hardirq"
    default n
    help
           Since most/all of our interrupt handlers disable interrupts
           during interrupt handling with the IRQF_DISABLED flag, Linux
           cannot track time spent in hardirq handling with the normal
           tick sampling mechanism.  This option enables code to count
           cycles spent in hardirq and adds a tick to kernel_stat.irq
           when the number of cycles spent reaches 1 tick.  This mechanism 
           is similar to CONFIG_VIRT_CPU_ACCOUNTING 

config BCM_BOARD
	bool "Support for Broadcom Board"
	depends on BCM96368 || BCM96816 || BCM96362 || BCM96328 || BCM963268

config BCM_CHIPINFO
	tristate "Support for Broadcom chipinfo"
	depends on BCM96368 || BCM96816 || BCM96362 || BCM96328 || BCM963268

config BCM_SERIAL
	tristate "Support for Serial Port"
	depends on BCM96368 || BCM96816 || BCM96362 || BCM96328 || BCM963268
	select SERIAL_CORE
	select SERIAL_CORE_CONSOLE


config L2TP
	tristate "Support for L2TP"
	depends on BCM96368 || BCM96816 || BCM96362 || BCM96328 || BCM963268

config BCM_SPU
        tristate "Support for IPSec SPU"
        depends on BCM96368 || BCM96816 || BCM96362 || BCM963268
        help
                Say 'M' to include support for IPSec SPU.

config BCM_SPU_TEST
        bool "Support for IPSec SPU Test code"
        depends on BCM_SPU || BCM96368 || BCM96816 || BCM96362 || BCM963268
        help
                Say 'M' to include support for IPSec SPU.

config BCM_PKTFLOW
	tristate "Support for Broadcom Packet Flow Cache"
        depends on BCM96368 || BCM96816 || BCM96362 || BCM96328 || BCM963268
	help
		Say 'M' to include support for Broadcom Packet Flow Cache.
		Static compile not supported.

config BCM_PKTCMF
	tristate "Support for Packet CMF"
        depends on BCM96368 || BCM96816
	help
		Say 'M' to include support for Packet CMF.
		Static compile not supported.

config BCM_INGQOS
	tristate "Support for Ingress QoS"
        depends on BCM96368 || BCM96816 || BCM96362 || BCM96328 || BCM963268
	help
		Say 'M' to include support for Ingress QoS.

config BRCM_DEF_BUF_MEM_PRCNT
	int "Buffer Memory as % of Total Memory"
	range 1 100

config BCM_BPM
	tristate "Support for Buffer Pool Manager"
        depends on BCM96368 || BCM96816 || BCM96362 || BCM96328 || BCM963268
	help
		Say 'M' to include support for BPM 

config BCM_FAP
	tristate "Support for Forward Assist Processor (FAP)"
        depends on BCM96362 || BCM963268
	help
		Say 'M' to include support for FAP.
		Static compile not supported.

config BCM_PKTDMA
	tristate "Support for Packet DMA"
        depends on BCM96368 || BCM96816 || BCM96362 || BCM96328 || BCM963268
	help
		Say 'M' to include support for Packet DMA.
		Dynamic compile not supported.

config BCM_ENET
	tristate "Support for Ethernet"
        depends on BCM96368 || BCM96816 || BCM96362 || BCM96328 || BCM963268

config BCM_DEF_NR_RX_DMA_CHANNELS
	int "Number of RX DMA Channels"
	range 1 4

config BCM_DEF_NR_TX_DMA_CHANNELS
	int "Number of TX DMA Channels"
	range 1 4

config BCM_PKTDMA_RX_SPLITTING
	bool "PktDma Iudma Rx Splitting"
	depends on BCM_PKTDMA && BCM_FAP

config BCM_PKTDMA_TX_SPLITTING
        bool "PktDma Iudma Tx Splitting"
	depends on BCM_PKTDMA && BCM_FAP

config EPON_SDK
	tristate "Support for EPON"
        depends on BCM96362 || BCM96328

config EPON_SDK_VOICE_OAM
	tristate "Support for EPON Voice OAM"
        depends on BCM96362 || BCM96328

config BCM_GPON
	tristate "Support for GPON"
        depends on BCM96368 || BCM96816

config BCM_LASER
	tristate "Support for LASER"
        depends on BCM96816
        
config BCM_GPON_FPGA
        bool "Support for GPON FPGA"
        depends on BCM_GPON

config BCM_GPON_160MHz_FFE
        bool "160MHz FFE"
        depends on BCM96816

config BCM_GPON_802_1Q_ENABLED
        bool "802_1Q mode enabled"
        depends on BCM96816

config BCM_GPON_AE_AUTO_SWITCH
        bool "Enable GPON-ActiveE Auto Switch"
        depends on BCM96816

config BCM_MoCA
        tristate "Support for MoCA"
        depends on BCM96816
        help
                Select 'M' to include support for Broadcom MoCA Solution.
                No Support For Static Build Model.

config BCM_MOCA_SOFT_SWITCHING
        bool "Enable software switching for MoCA"
        depends on BCM96816 || BCM_MoCA

config BCM_DEFAULT_CONSOLE_LOGLEVEL
	int "Default console printk loglevel"
	help
	  8: allow all levels to go to console
	  7: allow all levels except for LOG_DEBUG to go to console
	  6: allow all levels except for LOG_DEBUG and LOG_INFO
	  etc, etc

config BCM_LOG
        tristate "Support for BCM LOG"
        depends on BCM96368 || BCM96816 || BCM96362 || BCM96328 || BCM963268
        
config BCM_COLORIZE_PRINTS
        bool "Color code various prints"
        help
                If yes, various prints, including asserts, printk, etc
                will be colorized

config BCM_ASSERTS
        bool "Compile in assert code"
        help
                If no, assert code will be compiled out which reduces
                code size and improves performance

config BCM_FATAL_ASSERTS
        bool "Generate a fatal error when assert fails"

config BCM_I2C_BUS
        tristate "Support for I2C Bus Drivers"
        depends on BCM96816

config BCM_I2C_CHIP
        tristate "Support for I2C Chip Drivers"
        depends on BCM96816

config BCM_VLAN
        tristate "Support for BCM VLAN"
        depends on BCM96368 || BCM96816 || BCM96362 || BCM96328 || BCM963268

config BCM_USB
	tristate "Support for USB"
        depends on BCM96368 || BCM96816 || BCM96362 || BCM96328 || BCM963268

config BCM_ISDN
	tristate "Support for ISDN"
        depends on BCM96368 || BCM96816 || BCM96362 || BCM96328 || BCM963268

config BCM_WLAN
	tristate "Support for Wireless"
        depends on BCM96368 || BCM96816 || BCM96362 || BCM96328 || BCM963268

config BCM_WAPI
	bool "Support for Wireless WAPI"
        depends on BCM_WLAN

config BCM_WLALTBLD
	string "Wireless Alternate Build"
        depends on BCM_WLAN

config BCM_MEDIA
	bool "Support for Wireless MEDIA"
        depends on BCM_WLAN

config BCM_WLAN_IMPL_SELECT
	string "Support for Wireless IMPL selection"
        depends on BCM_WLAN
config BCM_PCI
	bool "Support for PCI"
        depends on BCM96368 || BCM96816 || BCM96362 || BCM96328 || BCM963268
	select PCI

config BCM_WLAN_USBAP
	bool "Support for Wireless USBAP"
	depends on BCM96368 || BCM96362 || BCM96328 || BCM963268


config BCM_XTMCFG
	tristate "Support for XTM"
	depends on BCM96368 || BCM96362 || BCM96328 || BCM963268

config BCM_XTMRT
	tristate "Support for XTM"
	depends on BCM96368 || BCM96362 || BCM96328 || BCM963268

config BCM_ADSL
	tristate "Support for ADSL"
	depends on BCM96368 || BCM96362 || BCM96328 || BCM963268

config BCM_EXT_BONDING
	tristate "Support for EXT_BONDING"
	depends on BCM96368 || BCM963268

config BCM_ENDPOINT
	tristate "Support for VOICE"
        depends on BCM96368 || BCM96816 || BCM96362 || BCM96328 || BCM963268

config BCM_DECT
	tristate "Support for DECT"
        depends on BCM96362 || BCM963268

config BCM_DECTSHIM
	tristate "Support for DECTSHIM"
        depends on BCM96362 || BCM963268

config BCM_BCMPROF
	tristate "Support for profiling"
        depends on BCM96368 || BCM96816 || BCM96362 || BCM96328 || BCM963268

config BCM_PWRMNGT
	tristate "Support for Power Management"
	depends on BCM96368 || BCM96816 || BCM96362 || BCM96328 || BCM963268

config BCM_WATCHDOG
        tristate "Support for Broadcom  Watchdog"
        depends on BCM96368 || BCM963268
	
config BCM_ETH_PWRSAVE
    bool "Support for Ethernet Auto Power Down and Sleep"
	depends on BCM96368 || BCM96816 || BCM96362 || BCM96328 || BCM963268
	
config BCM_ETH_HWAPD_PWRSAVE
    bool "Support for Ethernet HW Auto Power Down for external PHYs"
	depends on BCM96368 || BCM96816 || BCM96362 || BCM96328 || BCM963268

config BCM_HOSTMIPS_PWRSAVE
    bool "Support for PWRMNGT MIPS clock divider"
	depends on BCM96368 || BCM96816 || BCM96362 || BCM96328 || BCM963268

config BCM_HOSTMIPS_PWRSAVE_TIMERS
    bool "Hostmips Power Save Timers"
	depends on BCM96368 || BCM96816 || BCM96362 || BCM96328

config BCM_DDR_SELF_REFRESH_PWRSAVE
    bool "Support for DRAM Sleft Refresh mode"
	depends on BCM96368 || BCM96816 || BCM96362 || BCM96328 || BCM963268

config BCM_AVS_PWRSAVE
    bool "Support for Automatic Voltage Scaling"
	depends on BCM96368 || BCM96816 || BCM96362 || BCM963268

config BCM_1V2REG_AUTO_SHUTDOWN
	bool "Support for Automatically Shutting down Internal 1.2V Regulator"
	depends on BCM963268

config BCM_1V2REG_ALWAYS_SHUTDOWN
	bool "Support for Overriding Automatically Shutting down Internal 1.2V Regulator"
	depends on BCM963268

config BCM_1V2REG_NEVER_SHUTDOWN
	bool "Support for Overriding Automatically Shutting down Internal 1.2V Regulator"
	depends on BCM963268

config BCM_CPLD1
    bool "Support for CPLD standby timer"
	depends on BCM96368 || BCM96816 || BCM96362 || BCM96328 || BCM963268
	
config BCM_BCMDSP
	tristate "Support for DSP application"
        depends on BCM96368 || BCM96816 || BCM96362 || BCM96328 || BCM963268

config BCM_PROCFS
	tristate "Support for PROCFS"
        depends on BCM96368 || BCM96816 || BCM96362 || BCM96328 || BCM963268

config BCM_P8021AG
	tristate "Support for IEEE P8021.ag"
        depends on BCM96368 || BCM96816 || BCM96362 || BCM96328 || BCM963268

config BCM_SPU
	tristate "Support for SPU IPSec Engine"
	depends on BCM96368 || BCM96816 || BCM96362 || BCM963268

config BCM_TRNG
	tristate "BCM HW Random Number Generator support"
	depends on HW_RANDOM || BCM96368 || BCM96816 || BCM96362 || BCM963268
	---help---
	  This driver provides kernel-side support for the Random Number
	  Generator hardware found on bcm.

	  To compile this driver as a module, choose M here: the
	  module will be called intel-rng.

	  If unsure, say Y.

config BCM_ARL
	tristate "Support for ARL Table Management"
        depends on BCM96328 || BCM96362 || BCM963268
	help
		Say 'M' to include support for ARL.
		Static compile not supported.

config BCM_BOARD_IMPL
	int "Implementation index for ADSL Board"
	depends on BCM96368 || BCM96816 || BCM96362 || BCM96328 || BCM963268

config BCM_CHIPINFO_IMPL
	int "Implementation index for Chipinfo module"
	depends on BCM96368 || BCM96816 || BCM96362 || BCM96328 || BCM963268

config BCM_SERIAL_IMPL
	int "Implementation index for Serial"
	depends on BCM96368 || BCM96816 || BCM96362 || BCM96328 || BCM963268

config BCM_SPU_IMPL
        int "Implementation index for IPSec SPU"
        depends on BCM96368 || BCM96816 || BCM96362 || BCM963268

config BCM_TRNG_IMPL
	int "Implementation index for TRNG "
	depends on BCM96368 || BCM96816 || BCM96362 || BCM963268

config BCM_PKTFLOW_IMPL
	int "Implementation index for Broadcom Flow Cache"
	depends on BCM96816 || BCM96368 || BCM96362 || BCM96328 || BCM963268

config BCM_PKTCMF_IMPL
	int "Implementation index for Packet CMF"
        depends on BCM96368 || BCM96816

config BCM_INGQOS_IMPL
	int "Implementation index for Ingress QoS"
	    depends on BCM96816 || BCM96368 || BCM96362 || BCM96328 || BCM963268

config BCM_BPM_IMPL
	int "Implementation index for BPM"
	    depends on BCM96816 || BCM96368 || BCM96362 || BCM96328 || BCM963268

config BCM_FAP_IMPL
	int "Implementation index for FAP"
        depends on BCM96362 || BCM963268

config BCM_PKTDMA_IMPL
	int "Implementation index for Packet DMA"
        depends on BCM96368 || BCM96816 || BCM96362 || BCM96328 || BCM963268

config BCM_ENET_IMPL
	int "Implementation index for Ethernet"
        depends on BCM96368 || BCM96816 || BCM96362 || BCM96328 || BCM963268

config BCM_GPON_IMPL
	int "Implementation index for GPON"
        depends on BCM96816

config BCM_LASER_IMPL
	int "Implementation index for LASER"
        depends on BCM96816
        
config BCM_MoCA_IMPL
        int "Implementation index for MoCA"
        depends on BCM96816

config BCM_LOG_IMPL
        int "Implementation index for BCM LOG"
        depends on BCM96368 || BCM96816 || BCM96362 || BCM96328 || BCM963268

config BCM_I2C_BUS_IMPL
        int "Implementation index for I2C Bus"
        depends on BCM96816

config BCM_I2C_CHIP_IMPL
        int "Implementation index for I2C Chip"
        depends on BCM96816

config BCM_VLAN_IMPL
        int "Implementation index for BCM VLAN"
        depends on BCM96368 || BCM96816 || BCM96362 || BCM96328 || BCM963268

config BCM_USB_IMPL
	int "Implementation index for USB"
        depends on BCM96368 || BCM96816 || BCM96362 || BCM96328 || BCM963268

config BCM_ISDN_IMPL
	int "Implementation index for ISDN"
        depends on BCM96368 || BCM96816 || BCM96362 || BCM96328 || BCM963268

config BCM_WLAN_IMPL
	int "Implementation index for WIRELESS"
        depends on BCM96368 || BCM96816 || BCM96362 || BCM96328 || BCM963268

config BCM_XTMCFG_IMPL
	int "Implementation index for XTMCFG"
	depends on BCM96368 || BCM96362 || BCM96328 || BCM963268

config BCM_XTMRT_IMPL
  	int "Implementation index for XTMRT"
	depends on BCM96368 || BCM96362 || BCM96328 || BCM963268

config BCM_ADSL_IMPL
	int "Implementation index for ADSL"
	depends on BCM96368 || BCM96362 || BCM96328 || BCM963268

config BCM_EXT_BONDING_IMPL
	int "Implementation index for EXT_BONDING"
	depends on BCM96368 || BCM963268

config BCM_ENDPOINT_IMPL
	int "Implementation index for VOICE"
        depends on BCM96368 || BCM96816 || BCM96362 || BCM96328 || BCM963268

config BCM_DECT_IMPL
	int "Implementation index for DECT"
        depends on BCM96362 || BCM963268

config BCM_DECTSHIM_IMPL
	int "Implementation index for DECTSHIM"
        depends on BCM96362 || BCM963268

config BCM_BCMPROF_IMPL
	int "Implementation index for DSP APPLICATION"
        depends on BCM96368 || BCM96816 || BCM96362 || BCM96328 || BCM963268

config BCM_BCMDSP_IMPL
	int "Implementation index for PROFILING"
        depends on BCM96368 || BCM96816 || BCM96362 || BCM96328 || BCM963268

config BCM_PROCFS_IMPL
	int "Implementation index for PROCFS"
        depends on BCM96368 || BCM96816 || BCM96362 || BCM96328 || BCM963268

config BCM_WATCHDOG_IMPL
        int "Implementation index for Broadcom Watchdog
        depends on BCM96368 || BCM963268

config BCM_PWRMNGT_IMPL
	int "Implementation index for PWRMNGT"
	depends on BCM96368 || BCM96816 || BCM96362 || BCM96328 || BCM963268

config BCM_P8021AG_IMPL
	int "Implementation index for IEEE P8021AG"
        depends on BCM96368 || BCM96816 || BCM96362 || BCM96328 || BCM963268

config BCM_SPU_IMPL
	int "Implementation index for SPU IPSec Engine"
	depends on BCM96368 || BCM96816 || BCM96362 || BCM963268

config BCM_ARL_IMPL
	int "Implementation index for ARL"
        depends on BCM96328 || BCM96362 || BCM963268

choice
	prompt "Root File System"
	depends on MIPS_BRCM
	default ROOTFS_SQUASHFS
	help
	  Select root file system on the board flash. 

config ROOTFS_SQUASHFS
        bool "SQUASHFS"
config ROOTFS_CRAMFS
        bool "CRAMFS"
config ROOTFS_UBIFS
        bool "UBIFS"
config ROOTFS_JFFS2
        bool "JFFS2"
config ROOTFS_NFS
        bool "NFS"

endchoice

config ROOT_FLASHFS
	string "flash partition"
	depends on ROOTFS_SQUASHFS || ROOTFS_CRAMFS || ROOTFS_JFFS2 || ROOTFS_UBIFS
	default "root=31:0 ro noinitrd" if ROOTFS_SQUASHFS = y || ROOTFS_CRAMFS = y
	default "root=31:0 rw rootfstype=jffs2" if ROOTFS_JFFS2 = y
	default "root=ubi0:rootfs rootfstype=ubifs" if ROOTFS_UBIFS = y
	help
	  This is the root file system partition on flash memory

config ROOT_NFS_DIR
	string "NFS server path"
	depends on ROOTFS_NFS
	default "/opt/bcm96362/targets/96362GW/fs"
	help
	  This is the path of NFS server (host system)

config BRCM_KTOOLS
	bool "BRCM_KTOOLS"
	default n
	help
		Enables the build of BRCM MIPS Kernel Tools Support for PMON, BOUNCE


config PMON
	bool "PMON"
	depends on BRCM_KTOOLS
	default n
	help
	  Enables the support for MIPS Performance Monitoring Counters

config BRCM_BOUNCE
	bool "BOUNCE"
	depends on BRCM_KTOOLS
	default n
	help
	  This option enables the support for -finstrument-functions.

config BRCM_BOUNCE_EXIT
	bool "BOUNCE_EXIT"
	depends on BRCM_BOUNCE
	default n
	help
	  This option enables the instrumentation of kernel function call exit.

config BRCM_BOUNCE_DATAPATH
	bool "BOUNCE_DATAPATH"
	depends on BRCM_BOUNCE
	default n
	help
	  This option enables the brute force instrumentation of network data path.

config BCM_EXT_SWITCH
	int "The External Switch Number"
	default 0

choice
	prompt "Restrict memory used (testing)"

config BRCM_MEMORY_RESTRICTION_OFF
	bool "Use all available"

config BRCM_MEMORY_RESTRICTION_16M
	bool "Use 16M"

config BRCM_MEMORY_RESTRICTION_32M
	bool "Use 32M"

config BRCM_MEMORY_RESTRICTION_64M
	bool "Use 64M"

endchoice

config BRCM_OLT_FPGA_RESTORE
	bool "BRCM_OLT_FPGA_RESTORE"
	depends on BCM96368 
	default n
	help
	  Enables /proc/brcm/olt_fpga_restore
```
